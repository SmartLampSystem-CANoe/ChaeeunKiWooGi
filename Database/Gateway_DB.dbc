VERSION ""

NS_ :

BS_:

BU_: Lamp_Gateway C_Gateway P_Gateway

BO_ 0 msg_EngineInfo: 1 P_Gateway
 SG_ sig_VehicleSpeed : 0|8@1+ (1,0) [0|200] "km/h"  Lamp_Gateway

BO_ 512 msg_SteeringInfo: 2 C_Gateway
 SG_ sig_SteeringAngle : 0|11@1- (1,0) [-540|540] "degree"  Lamp_Gateway

BO_ 256 msg_BrakeInfo: 8 C_Gateway
 SG_ CRC : 0|8@1- (1,0) [-128|127] "" Vector__XXX
 SG_ sig_BrakePress : 8|1@1+ (1,0) [0|1] ""  P_Gateway,Lamp_Gateway

BA_DEF_  "DatabaseVersion" STRING ;
BA_DEF_  "Manufacturer" STRING ;
BA_DEF_  "BusType" STRING ;
BA_DEF_ SG_  "GenSigStartValue" FLOAT 0 1215752192;
BA_DEF_ SG_  "GenSigSendType" ENUM  "Cyclic","OnWrite","OnWriteWithRepetition","OnChange","OnChangeWithRepetition","IfActive","IfActiveWithRepetition","NoSigSendType","NotUsed","NotUsed","NotUsed","NotUsed","NotUsed";
BA_DEF_ BO_  "GenMsgSendType" ENUM  "Cyclic","NotUsed","NotUsed","NotUsed","NotUsed","Cyclic","NotUsed","IfActive","NoMsgSendType","NotUsed","vector_leerstring";
BA_DEF_ BO_  "GenMsgCycleTime" INT 0 50000;
BA_DEF_ BO_  "GenMsgCycleTimeFast" INT 0 50000;
BA_DEF_ BO_  "GenMsgILSupport" ENUM  "No","Yes";
BA_DEF_DEF_  "DatabaseVersion" "";
BA_DEF_DEF_  "Manufacturer" "Vector";
BA_DEF_DEF_  "BusType" "CAN";
BA_DEF_DEF_  "GenSigStartValue" 0;
BA_DEF_DEF_  "GenSigSendType" "Cyclic";
BA_DEF_DEF_  "GenMsgSendType" "NoMsgSendType";
BA_DEF_DEF_  "GenMsgCycleTime" 200;
BA_DEF_DEF_  "GenMsgCycleTimeFast" 20;
BA_DEF_DEF_  "GenMsgILSupport" "Yes";
BA_ "DatabaseVersion" "1.1";
BA_ "GenSigSendType" SG_ 0 sig_VehicleSpeed 7;
BA_ "GenSigSendType" SG_ 512 sig_SteeringAngle 7;
BA_ "GenSigSendType" SG_ 256 sig_BrakePress 7;

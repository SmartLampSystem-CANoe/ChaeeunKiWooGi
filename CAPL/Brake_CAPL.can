/*@!Encoding:65001*/
includes
{
  
}

variables
{
  const int PRESS = 1;
  const int UNPRESS = 0;
  msTimer sendTimer;
}

on start {
  setTimerCyclic(sendTimer, 20);
}

on sysvar sysvar::Brake::press
{
  if(@sysvar::Brake::press == PRESS) {
    $sig_BrakePress = 1;
  }
  else if(@sysvar::Brake::press == UNPRESS) {
    $sig_BrakePress = 0;
  }
  else {
    
  }
}


on timer sendTimer {
  message C_CAN::msg_BrakeInfo sendMsg;
  
  byte data[1];
  dword crc;
  
  sendMsg.sig_BrakePress = @sysvar::Brake::press;
  
  data[0] = sendMsg.byte(1);
  Crc_CalculateCRC8(data, elcount (data), 0, elcount (data), 0, 1, crc);
  sendMsg.CRC = crc;

  output(sendMsg);
}

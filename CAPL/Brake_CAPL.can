/*@!Encoding:65001*/
includes
{
  
}

variables
{
  const int PRESS = 1;
  const int UNPRESS = 0;
}

on sysvar sysvar::Brake::press
{
  if(@sysvar::Brake::press == 1) {
    $sig_BrakePress = 1;
  }
  else if(@sysvar::Brake::press == 0) {
    $sig_BrakePress = 0;
  }
  else {
    
  }
}

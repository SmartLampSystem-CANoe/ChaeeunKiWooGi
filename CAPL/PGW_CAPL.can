/*@!Encoding:65001*/
includes
{
  
}

variables
{
  
}

on message can1.Powertrain_DB::msg_EngineInfo
{
  message Gateway_DB::msg_EngineInfo msg_forward;
  
  msg_forward.sig_VehicleSpeed = this.sig_VehicleSpeed;
  msg_forward.can = 4;
  
  output(msg_forward);
}